#include<reg52.h>
#include<absacc.h>
#include"frag1.h"
#include"frag4.h"
#include"frag5.h"
#define PA XBYTE [0x7ffc]
#define COM XBYTE [0x7fff]
unsigned int n;
unsigned char DOTBIT[8]={0xfe,0xfd,0xfb,0xf7,0xef,0xdf,0xbf,0x7f};//列码
unsigned char DOTMAP[]={
		0x00,0xff,0xff,0xc3,0xc3,0xff,0xff,0x00,//0 行码
    0x00,0x00,0x00,0xff,0xff,0x00,0x00,0x00,//1
    0x00,0xfb,0xfb,0xdb,0xdb,0xdf,0xdf,0x00,//2
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    0x00,0xdf,0xdf,0xdb,0xdb,0xff,0xff,0x00,//9
};
void Delay1(unsigned char CNT){//延时
		unsigned char i;
  	while(CNT--)
    for(i=0;i<100;i++);
}
void Dotmatrix(){//点阵显示接口
		unsigned char i,k=60;
  	if(!TestKey()){
		for(k;k>0;k--){
 			for(i=0;i<8;i++){		
				P1=DOTBIT[i];//分列点亮
	  	 		PA=DOTMAP[i+n*8];//送行码
	  			Delay1(2);
    		}
  		}
	}
}
void juzhenled(){
  	COM=mode;
    for(n=0;n<10;n++){
		Dotmatrix();	
	}
	P1=0xff;//分列点亮
}